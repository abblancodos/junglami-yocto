## conf/layer.conf
```bitbake
BBPATH .= ":${LAYERDIR}"
BBFILES += "${LAYERDIR}/recipes-*/*/*.bb \
            ${LAYERDIR}/recipes-*/*/*.bbappend"
BBFILE_COLLECTIONS += "junglami-yocto"
BBFILE_PATTERN_junglami-yocto = "^${LAYERDIR}/"
BBFILE_PRIORITY_junglami-yocto = "110"
LAYERDEPENDS_junglami-yocto = "core"
LAYERSERIES_COMPAT_junglami-yocto = "scarthgap"

# Kernel
PREFERRED_PROVIDER_virtual/kernel            = "linux-junglami-dsp-plgnd"
PREFERRED_VERSION_linux-junglami-dsp-plgnd   = "6.12%"

# Graphics — mesa es el único provider para RK3566/Panfrost
PREFERRED_PROVIDER_virtual/libgl             = "mesa"
PREFERRED_PROVIDER_virtual/mesa              = "mesa"
PREFERRED_PROVIDER_virtual/libgles2          = "mesa"
PREFERRED_PROVIDER_virtual/libgles3          = "mesa"
PREFERRED_PROVIDER_virtual/egl               = "mesa"
PREFERRED_PROVIDER_virtual/nativesdk-libgl   = "nativesdk-mesa"
PREFERRED_PROVIDER_virtual/nativesdk-egl     = "nativesdk-mesa"
PREFERRED_PROVIDER_virtual/libgl-native      = "mesa-native"
```
