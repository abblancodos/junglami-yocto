## dsp-playground/conf/layer.conf
```bitbake
# We have a conf and classes directory, add to BBPATH
BBPATH .= ":${LAYERDIR}"

# We have recipes-* directories, add to BBFILES
BBFILES += "${LAYERDIR}/recipes-*/*/*.bb \
            ${LAYERDIR}/recipes-*/*/*.bbappend"

BBFILE_COLLECTIONS += "dsp-playground"
BBFILE_PATTERN_dsp-playground = "^${LAYERDIR}/"
BBFILE_PRIORITY_dsp-playground = "6"

LAYERDEPENDS_dsp-playground = "core"
LAYERSERIES_COMPAT_dsp-playground = "scarthgap"
```
